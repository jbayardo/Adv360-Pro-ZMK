## config/west.yml
```yaml
manifest:
  remotes:
    - name: zmkfirmware
      url-base: https://github.com/zmkfirmware
    - name: jbayardo
      url-base: https://github.com/jbayardo
  projects:
    - name: zmk
      remote: jbayardo
      revision: main
      import: app/west.yml
  self:
    path: config
```
