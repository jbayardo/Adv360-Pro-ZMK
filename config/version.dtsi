#define VERSION_MACRO
macro_ver: macro_ver {
compatible = "zmk,behavior-macro";
label = "macro_ver";
#binding-cells = <0>;
bindings = <&kp N2>, <&kp N0>, <&kp N2>, <&kp N3>, <&kp N1>, <&kp N2>, <&kp N2>, <&kp N2>, <&kp MINUS>, <&kp V>, <&kp N3>, <&kp DOT>, <&kp N0>, <&kp MINUS>, <&kp N8>, <&kp N5>, <&kp E>, <&kp N8>, <&kp N6>, <&kp N3>, <&kp N3>, <&kp RET>;
};
