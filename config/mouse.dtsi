#include <dt-bindings/zmk/mouse.h>

&mmv {
  acceleration-exponent = <1>;
  time-to-max-speed-ms = <40>;
  delay-ms = <0>;
};

&mwh {
  acceleration-exponent = <0>;
  time-to-max-speed-ms = <40>;
  delay-ms = <10>;
};

#define UMOUSE_MOVE_MAX 600
#define UMOUSE_SCROLL_MAX 10

#undef MOVE_UP
#undef MOVE_DOWN
#undef MOVE_LEFT
#undef MOVE_RIGHT
#define MOVE_UP MOVE_VERT(-UMOUSE_MOVE_MAX)
#define MOVE_DOWN MOVE_VERT(UMOUSE_MOVE_MAX)
#define MOVE_LEFT MOVE_HOR(-UMOUSE_MOVE_MAX)
#define MOVE_RIGHT MOVE_HOR(UMOUSE_MOVE_MAX)

#undef SCROLL_UP
#undef SCROLL_DOWN
#undef SCROLL_LEFT
#undef SCROLL_RIGHT
#define SCROLL_UP SCROLL_VERT(UMOUSE_SCROLL_MAX)
#define SCROLL_DOWN SCROLL_VERT(-UMOUSE_SCROLL_MAX)
#define SCROLL_LEFT SCROLL_HOR(-UMOUSE_SCROLL_MAX)
#define SCROLL_RIGHT SCROLL_HOR(UMOUSE_SCROLL_MAX)

#define UBT1 &mkp MB1
#define UBT2 &mkp MB2
#define UBT3 &mkp MB3
#define UMSL &mmv MOVE_LEFT
#define UMSD &mmv MOVE_DOWN
#define UMSR &mmv MOVE_RIGHT
#define UMSU &mmv MOVE_UP
#define UWHD &mwh SCROLL_DOWN
#define UWHL &mwh SCROLL_LEFT
#define UWHR &mwh SCROLL_RIGHT
#define UWHU &mwh SCROLL_UP